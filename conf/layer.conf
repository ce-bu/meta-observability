## conf/layer.conf
```bitbake
# We have a conf and classes directory, add to BBPATH
BBPATH .= ":${LAYERDIR}"

# We have recipes-* directories, add to BBFILES
BBFILES += "${LAYERDIR}/recipes-*/*/*.bb \
            ${LAYERDIR}/recipes-*/*/*.bbappend"

BBFILE_COLLECTIONS += "meta-bpf"
BBFILE_PATTERN_meta-bpf = "^${LAYERDIR}/"
BBFILE_PRIORITY_meta-bpf = "6"

LAYERDEPENDS_meta-bpf = "core"
LAYERSERIES_COMPAT_meta-bpf = "dunfell gatesgarth hardknott honister"

KERNEL_FEATURES:append:pn-linux-yocto =" cfg/tracing.scc features/bpf/bpf.scc features/reproducibility/reproducibility.scc"
```
